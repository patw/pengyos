## buildroot-external/package/accountsservice/Config.in
```kconfig
config BR2_PACKAGE_ACCOUNTSSERVICE
	bool "accountsservice"
	depends on BR2_PACKAGE_SYSTEMD
	depends on BR2_PACKAGE_POLKIT
	help
	  The D-Bus service for user accounts (org.freedesktop.Accounts):
	  COSMIC Settings' Users page lists, adds and edits accounts,
	  names and pictures through it.

	  https://gitlab.freedesktop.org/accountsservice/accountsservice
```

## buildroot-external/package/alsa-ucm-conf/Config.in
```kconfig
config BR2_PACKAGE_ALSA_UCM_CONF
	bool "alsa-ucm-conf"
	depends on BR2_PACKAGE_ALSA_LIB
	help
	  ALSA Use Case Manager (UCM) configuration — the "ucm2" tree
	  that alsa-lib reads at runtime from /usr/share/alsa/ucm2 to
	  describe a sound card's profiles, jacks and devices.

	  PipeWire / WirePlumber need it to build the real card profiles.
	  Without it the ALSA monitor exposes only a single generic
	  "Analog Stereo" profile, so an HDA card's HDMI/Display outputs
	  never appear as sinks (the N100's monitor speakers were
	  unreachable). Not shipped by Buildroot 2026.08 — this is a
	  PengyOS from-source data recipe.

	  https://github.com/alsa-project/alsa-ucm-conf
```

## buildroot-external/package/appstream/Config.in
```kconfig
config BR2_PACKAGE_APPSTREAM
	bool "appstream"
	depends on BR2_USE_WCHAR # libglib2
	depends on BR2_TOOLCHAIN_HAS_THREADS # libglib2
	depends on BR2_USE_MMU # libglib2
	select BR2_PACKAGE_LIBGLIB2
	select BR2_PACKAGE_LIBCURL
	select BR2_PACKAGE_LIBXML2
	select BR2_PACKAGE_LIBXMLB
	select BR2_PACKAGE_LIBFYAML
	help
	  AppStream: the metadata standard for software components
	  (descriptions, screenshots, categories) and its library.
	  Flatpak requires it; app stores read it. Not a stock
	  Buildroot 2026.08 package.

	  https://www.freedesktop.org/wiki/Distributions/AppStream/
```

## buildroot-external/package/bolt/Config.in
```kconfig
config BR2_PACKAGE_BOLT
	bool "bolt"
	depends on BR2_PACKAGE_SYSTEMD
	depends on BR2_PACKAGE_POLKIT
	select BR2_PACKAGE_LIBGLIB2
	help
	  Thunderbolt / USB4 device authorization (boltd + boltctl): new
	  Thunderbolt devices stay unconnected until enrolled. Buildroot
	  2026.08 does not ship it.

	  https://gitlab.freedesktop.org/bolt/bolt
```

## buildroot-external/package/cosmic-sound-theme/Config.in
```kconfig
config BR2_PACKAGE_COSMIC_SOUND_THEME
	bool "cosmic-sound-theme"
	select BR2_PACKAGE_SOUND_THEME_FREEDESKTOP
	help
	  System76's COSMIC sound theme (notifications, alerts,
	  battery, screen lock). Also answers COSMIC's hardcoded
	  "Pop" theme lookups; the freedesktop theme covers the ones
	  COSMIC makes under "freedesktop" (volume change, plug).

	  https://github.com/pop-os/cosmic-sound-theme
```

## buildroot-external/package/cosmic/Config.in
```kconfig
config BR2_PACKAGE_COSMIC
	bool "cosmic"
	depends on BR2_PACKAGE_HOST_RUSTC_TARGET_ARCH_SUPPORTS
	depends on BR2_PACKAGE_SYSTEMD # libudev
	depends on BR2_PACKAGE_MESA3D_GBM
	depends on BR2_PACKAGE_FLATPAK # cosmic-store
	depends on BR2_INSTALL_LIBSTDCPP
	select BR2_PACKAGE_HOST_RUSTC
	select BR2_PACKAGE_DAV1D
	select BR2_PACKAGE_DBUS
	select BR2_PACKAGE_GSTREAMER1
	select BR2_PACKAGE_GST1_PLUGINS_BASE
	select BR2_PACKAGE_LIBDISPLAY_INFO_PENGYOS
	select BR2_PACKAGE_LIBGLIB2
	select BR2_PACKAGE_LIBINPUT
	select BR2_PACKAGE_LIBXKBCOMMON
	select BR2_PACKAGE_LINUX_PAM
	select BR2_PACKAGE_PIPEWIRE
	select BR2_PACKAGE_PIXMAN
	select BR2_PACKAGE_SEATD
	help
	  The COSMIC desktop: compositor, session, panel, applets, settings, greeter
	  and apps, at the commits pinned in scripts/cosmic-components.tsv, built as
	  one cargo workspace-like set so shared crates compile once.

	  https://github.com/pop-os/cosmic-epoch
```

## buildroot-external/package/cutecosmic/Config.in
```kconfig
config BR2_PACKAGE_CUTECOSMIC
	bool "cutecosmic"
	depends on BR2_PACKAGE_QT6
	depends on BR2_PACKAGE_HOST_RUSTC_TARGET_ARCH_SUPPORTS
	select BR2_PACKAGE_HOST_RUSTC
	select BR2_PACKAGE_QT6BASE_GUI
	select BR2_PACKAGE_QT6BASE_DBUS
	help
	  Qt platform theme for the COSMIC desktop: Qt applications
	  follow COSMIC's dark/light mode, accent colours, fonts, icon
	  theme and file dialogs. Loaded automatically inside a COSMIC
	  session.

	  Uses private Qt APIs: rebuild it whenever Qt changes.

	  https://github.com/IgKh/cutecosmic

comment "cutecosmic needs Qt6"
	depends on !BR2_PACKAGE_QT6
```

## buildroot-external/package/dconf/Config.in
```kconfig
config BR2_PACKAGE_DCONF
	bool "dconf"
	depends on BR2_PACKAGE_LIBGLIB2
	depends on BR2_PACKAGE_DBUS
	help
	  The GSettings backend GNOME, Pop!_OS and Ubuntu ship: a GIO
	  module (libdconfsettings.so), the D-Bus activated dconf-service
	  that applies every write in order, and the dconf CLI. Without
	  it GLib falls back to its keyfile backend, where each writer
	  rewrites the whole file and concurrent writes lose each other
	  (cosmic-settings-daemon writes its GNOME keys as concurrent
	  `gsettings set` processes).

	  https://gitlab.gnome.org/GNOME/dconf
```

## buildroot-external/package/ddcutil/Config.in
```kconfig
config BR2_PACKAGE_DDCUTIL
	bool "ddcutil"
	depends on BR2_PACKAGE_HAS_UDEV
	select BR2_PACKAGE_LIBGLIB2
	select BR2_PACKAGE_JANSSON
	select BR2_PACKAGE_ACL
	select BR2_PACKAGE_LIBDRM
	help
	  Control monitors over DDC/CI (brightness, contrast, input
	  source) through /dev/i2c-* (CONFIG_I2C_CHARDEV). Buildroot
	  2026.08 does not ship it.

	  https://www.ddcutil.com
```

## buildroot-external/package/desktop-file-utils-target/Config.in
```kconfig
config BR2_PACKAGE_DESKTOP_FILE_UTILS_TARGET
	bool "desktop-file-utils (target)"
	depends on BR2_USE_WCHAR # libglib2
	depends on BR2_TOOLCHAIN_HAS_THREADS # libglib2
	depends on BR2_USE_MMU # libglib2
	select BR2_PACKAGE_LIBGLIB2
	help
	  update-desktop-database and desktop-file-validate on the
	  target. Buildroot 2026.08 builds desktop-file-utils for the
	  host only; Flatpak's install trigger needs
	  update-desktop-database so new apps reach "Open with".

	  https://www.freedesktop.org/wiki/Software/desktop-file-utils/
```

## buildroot-external/package/distrobox/Config.in
```kconfig
config BR2_PACKAGE_DISTROBOX
	bool "distrobox"
	depends on BR2_PACKAGE_PODMAN
	help
	  Use any Linux distribution inside the terminal (podman
	  containers that share $HOME, the display and devices). The
	  developer's toolchain lane: Buildroot puts no compiler on the
	  target, so gcc/clang/rustc/go and headers live in a distrobox.
	  Buildroot 2026.08 does not ship it.

	  https://distrobox.it
```

## buildroot-external/package/ffmpegthumbnailer/Config.in
```kconfig
config BR2_PACKAGE_FFMPEGTHUMBNAILER
	bool "ffmpegthumbnailer"
	depends on BR2_PACKAGE_FFMPEG
	depends on BR2_INSTALL_LIBSTDCPP
	select BR2_PACKAGE_LIBPNG
	select BR2_PACKAGE_JPEG
	help
	  Video thumbnails for file managers: registers a freedesktop
	  thumbnailer (/usr/share/thumbnailers) that COSMIC Files runs
	  for video files.

	  https://github.com/dirkvdb/ffmpegthumbnailer
```

## buildroot-external/package/flatpak/Config.in
```kconfig
config BR2_PACKAGE_FLATPAK
	bool "flatpak"
	depends on BR2_PACKAGE_SYSTEMD # system helper, sysusers
	depends on BR2_PACKAGE_LIBGPG_ERROR_ARCH_SUPPORTS # libostree
	depends on BR2_TOOLCHAIN_HEADERS_AT_LEAST_5_8 # libostree
	depends on !BR2_TOOLCHAIN_USES_MUSL # libostree
	depends on BR2_USE_WCHAR # libglib2
	depends on BR2_TOOLCHAIN_HAS_THREADS # libglib2
	depends on BR2_USE_MMU # fork()
	depends on BR2_PACKAGE_LIBSECCOMP_ARCH_SUPPORTS
	select BR2_PACKAGE_APPSTREAM
	select BR2_PACKAGE_BUBBLEWRAP
	select BR2_PACKAGE_XDG_DBUS_PROXY
	select BR2_PACKAGE_GDK_PIXBUF
	select BR2_PACKAGE_JSON_GLIB
	select BR2_PACKAGE_LIBARCHIVE
	select BR2_PACKAGE_LIBCAP
	select BR2_PACKAGE_LIBCURL
	select BR2_PACKAGE_LIBFUSE3
	select BR2_PACKAGE_LIBGPGME
	select BR2_PACKAGE_LIBOSTREE
	select BR2_PACKAGE_LIBSECCOMP
	select BR2_PACKAGE_LIBSOUP3 # libostree only fetches over HTTP with it (then via curl)
	select BR2_PACKAGE_LIBXML2
	select BR2_PACKAGE_POLKIT # the system helper
	help
	  Flatpak: sandboxed desktop applications (the Desktop's app
	  lane, SPEC §2.5), with its system helper (installs for the
	  admin, authorized by polkit) and its portal (sub-sandboxes,
	  needed by Chromium/Electron apps and Steam).

	  Not a stock Buildroot 2026.08 package.

	  https://flatpak.org/
```

## buildroot-external/package/font-fira/Config.in
```kconfig
config BR2_PACKAGE_FONT_FIRA
	bool "font-fira"
	help
	  Mozilla's Fira Sans (all weights and italics) and Fira Mono:
	  the interface and monospace fonts COSMIC is designed around
	  (libcosmic's defaults). Without them COSMIC falls back to
	  whatever fontconfig finds.

	  https://github.com/mozilla/Fira
```

## buildroot-external/package/font-noto-cjk/Config.in
```kconfig
config BR2_PACKAGE_FONT_NOTO_CJK
	bool "font-noto-cjk"
	help
	  Noto Sans CJK: Chinese, Japanese and Korean text (web pages,
	  file names, chat), every weight in one variable-font
	  collection, as Fedora ships it. Without it CJK text showed as
	  empty boxes.

	  https://github.com/notofonts/noto-cjk
```

## buildroot-external/package/font-noto-color-emoji/Config.in
```kconfig
config BR2_PACKAGE_FONT_NOTO_COLOR_EMOJI
	bool "font-noto-color-emoji"
	help
	  Google's Noto Color Emoji (colour bitmap, CBDT). Without a
	  colour emoji font, emoji render as empty boxes or as
	  monochrome outline glyphs borrowed from other fonts.

	  https://github.com/googlefonts/noto-emoji
```

## buildroot-external/package/font-noto-symbols2/Config.in
```kconfig
config BR2_PACKAGE_FONT_NOTO_SYMBOLS2
	bool "font-noto-symbols2"
	help
	  Noto Sans Symbols 2: the Unicode symbol blocks no other
	  shipped font covers, e.g. the media-control triangles
	  (U+23F5, Claude Code's mode line) and Symbols for Legacy
	  Computing (U+1FB00, terminal graphs). Ubuntu ships it in
	  fonts-noto-core.

	  https://github.com/notofonts/symbols
```

## buildroot-external/package/font-symbols-nerd/Config.in
```kconfig
config BR2_PACKAGE_FONT_SYMBOLS_NERD
	bool "font-symbols-nerd"
	depends on BR2_PACKAGE_FONTCONFIG
	help
	  Symbols Nerd Font (and its Mono variant): the Nerd Fonts icon
	  glyphs alone, in the Private Use Area, with no letters.
	  starship's default prompt (the comfort shell), powerline
	  prompts, eza --icons and lazygit draw these; without a font
	  that has them every icon is a box. fontconfig's per-glyph
	  fallback finds them under any terminal font. Upstream's
	  10-nerd-font-symbols.conf is not installed: it makes this font
	  the preferred "monospace", which fallback does not need.

	  https://github.com/ryanoasis/nerd-fonts
```

## buildroot-external/package/fzf/Config.in
```kconfig
config BR2_PACKAGE_FZF
	bool "fzf"
	help
	  A command-line fuzzy finder: Ctrl-R for interactive history
	  search, Ctrl-T for a file picker (the Server comfort profile
	  wires both). Buildroot 2026.08 does not ship it; the recipe
	  also installs the bash/zsh key bindings and completion under
	  /usr/share/fzf.

	  https://github.com/junegunn/fzf
```

## buildroot-external/package/gamemode/Config.in
```kconfig
config BR2_PACKAGE_GAMEMODE
	bool "gamemode"
	depends on BR2_PACKAGE_SYSTEMD # sd-bus
	depends on BR2_PACKAGE_DBUS
	depends on BR2_PACKAGE_POLKIT # the CPU governor helper runs via pkexec
	select BR2_PACKAGE_INIH
	help
	  Feral's GameMode: while a game runs, switch the CPU governor
	  to performance, raise the game's priority and inhibit the
	  screensaver. Steam and Lutris request it; Flatpak games reach
	  it through the GameMode portal (xdg-desktop-portal already
	  offers that interface, which needs this daemon behind it).

	  https://github.com/FeralInteractive/gamemode
```
