## buildroot-external/package/pengy-solitaire/Config.in
```kconfig
config BR2_PACKAGE_PENGY_SOLITAIRE
	bool "pengy-solitaire"
	depends on BR2_PACKAGE_HOST_RUSTC_TARGET_ARCH_SUPPORTS
	select BR2_PACKAGE_HOST_RUSTC
	help
	  Frostbite Solitaire: Klondike, draw three, unlimited redeals — the
	  game every OS used to ship and PengyOS did not. The PengyOS pack-in
	  game in the cards slot (next to blocks, breakout, floe, icefield,
	  invaders, lander, merge, pong and rogue). Rust, std only, zero
	  dependencies: the recipe is an offline cargo build and the game needs
	  no libraries at run time. Terminal=true, so it runs in any terminal,
	  over ssh, and on Core.

	  h/j/k/l (or the arrows) move the cursor, space takes a run and drops
	  it, d draws three (an empty stock recycles the waste), f collects the
	  cards that are safe to send up, u undoes (50 deep), n deals a new
	  game, q quits. Standard Klondike scoring floored at zero, a move
	  counter, an elapsed timer, and a best score kept in
	  $XDG_DATA_HOME/pengyos/games/pengy-solitaire/, under the player's home.

	  --mono draws with plain ASCII when the locale cannot render the box
	  drawing and the suit characters; --headless proves it works where
	  there is no pty.

	  https://github.com/pengyos/tree/main/tools/pengy-solitaire
```

## buildroot-external/package/pengy/Config.in
```kconfig
config BR2_PACKAGE_PENGY
	bool "pengy"
	depends on BR2_PACKAGE_HOST_RUSTC_TARGET_ARCH_SUPPORTS
	select BR2_PACKAGE_HOST_RUSTC
	help
	  Pengy (PengyR): a local-first AI agent with tools, talking to
	  any OpenAI-compatible API. One Rust agent core behind three
	  front ends; pick the ones this image ships below. Unconfigured
	  by default: each user sets it up (~/.config/pengy).

	  https://github.com/patw/PengyR

if BR2_PACKAGE_PENGY

config BR2_PACKAGE_PENGY_CLI
	bool "pengy-cli (terminal)"
	default y
	help
	  Terminal REPL + single-shot mode. Rust only (glibc, libgcc).

config BR2_PACKAGE_PENGY_WEB
	bool "pengy-web (web UI)"
	help
	  Axum web UI with live streaming. Rust only.

config BR2_PACKAGE_PENGY_GUI
	bool "pengy (Qt6 desktop app)"
	depends on BR2_PACKAGE_QT6
	depends on BR2_INSTALL_LIBSTDCPP
	select BR2_PACKAGE_QT6BASE_GUI
	select BR2_PACKAGE_QT6BASE_WIDGETS
	select BR2_PACKAGE_QT6BASE_NETWORK
	select BR2_PACKAGE_QT6SVG
	select BR2_PACKAGE_OPENSSL
	help
	  The Qt6 desktop app; the Rust core is linked in statically.
	  Installs pengy.desktop + icon.

comment "pengy GUI needs Qt6"
	depends on !BR2_PACKAGE_QT6

endif
```

## buildroot-external/package/pengyos-initramfs-busybox/Config.in
```kconfig
config BR2_PACKAGE_PENGYOS_INITRAMFS_BUSYBOX
	bool "pengyos-initramfs-busybox"
	help
	  A static busybox with only the applets the installer ISO's
	  initramfs needs (sh, mount with loop support, switch_root and a
	  few tools). Installed into BINARIES_DIR for
	  board/common/iso-image.sh, never into the target: the images
	  ship GNU coreutils, not busybox.

	  https://busybox.net
```

## buildroot-external/package/plymouth/Config.in
```kconfig
config BR2_PACKAGE_PLYMOUTH
	bool "plymouth"
	depends on BR2_INIT_SYSTEMD
	depends on BR2_PACKAGE_HAS_UDEV
	select BR2_PACKAGE_LIBPNG
	select BR2_PACKAGE_LIBDRM
	select BR2_PACKAGE_LIBEVDEV
	select BR2_PACKAGE_LIBXKBCOMMON
	select BR2_PACKAGE_XKEYBOARD_CONFIG
	select BR2_PACKAGE_FREETYPE
	help
	  Graphical boot splash: draws on the DRM device from early
	  userspace until the desktop takes over, and survives the
	  firmware-framebuffer -> GPU-driver handoff. Ships the
	  PengyOS theme (Pengy + a spinner) as the default.

	  https://www.freedesktop.org/wiki/Software/Plymouth/

comment "plymouth needs systemd and udev"
	depends on !BR2_INIT_SYSTEMD || !BR2_PACKAGE_HAS_UDEV
```

## buildroot-external/package/pop-cursor-theme/Config.in
```kconfig
config BR2_PACKAGE_POP_CURSOR_THEME
	bool "pop-cursor-theme"
	help
	  The Pop mouse cursors (from Pop!_OS's icon theme), the
	  cursors COSMIC is designed with, installed as the system
	  default cursor theme (/usr/share/icons/default), and Pop's
	  symbolic icons (scalable/, 2.3 MB), which COSMIC's icon
	  theme inherits for the icons it does not draw. Pop's
	  fixed-size PNG icons are not installed.

	  https://github.com/pop-os/icon-theme
```

## buildroot-external/package/power-profiles-daemon/Config.in
```kconfig
config BR2_PACKAGE_POWER_PROFILES_DAEMON
	bool "power-profiles-daemon"
	depends on BR2_PACKAGE_SYSTEMD
	depends on BR2_PACKAGE_POLKIT
	select BR2_PACKAGE_LIBGLIB2
	select BR2_PACKAGE_LIBGUDEV
	select BR2_PACKAGE_UPOWER
	help
	  Power profiles (performance / balanced / power-saver) over
	  D-Bus (org.freedesktop.UPower.PowerProfiles) — what COSMIC's
	  power menu and Settings → Power switch between. Drives
	  intel_pstate / amd-pstate energy preferences and platform
	  profiles. Buildroot 2026.08 does not ship it.

	  https://gitlab.freedesktop.org/upower/power-profiles-daemon
```

## buildroot-external/package/rtkit/Config.in
```kconfig
config BR2_PACKAGE_RTKIT
	bool "rtkit"
	depends on BR2_PACKAGE_SYSTEMD
	depends on BR2_PACKAGE_POLKIT
	select BR2_PACKAGE_DBUS
	select BR2_PACKAGE_LIBCAP
	help
	  RealtimeKit (org.freedesktop.RealtimeKit1): hands bounded
	  realtime scheduling to unprivileged threads that ask for it.
	  The Realtime portal Flatpak apps use (audio workstations,
	  games, voice chat, PipeWire inside a sandbox) forwards to it;
	  without it every request failed and xdg-desktop-portal logged
	  "Failed to load RealtimeKit property" at each session start.

	  https://gitlab.freedesktop.org/pipewire/rtkit
```

## buildroot-external/package/sof-firmware/Config.in
```kconfig
config BR2_PACKAGE_SOF_FIRMWARE
	bool "sof-firmware"
	depends on BR2_x86_64
	help
	  Intel Sound Open Firmware: the audio DSP firmware and
	  topology files for Intel laptops (digital microphones,
	  SoundWire) with the kernel's SOF driver. Signed by Intel;
	  the files the kernel loads from /lib/firmware/intel.

	  https://github.com/thesofproject/sof-bin
```

## buildroot-external/package/steam-devices/Config.in
```kconfig
config BR2_PACKAGE_STEAM_DEVICES
	bool "steam-devices"
	help
	  Valve's udev rules giving the logged-in user access to game
	  controllers (Steam Controller/Deck, PlayStation, Xbox,
	  Nintendo, 8BitDo, …), VR headsets (Index, Vive) and
	  /dev/uinput, which Steam Input uses to present them as
	  virtual pads. Steam as a Flatpak cannot install these itself.

	  https://github.com/ValveSoftware/steam-devices
```

## buildroot-external/package/sudo-rs/Config.in
```kconfig
config BR2_PACKAGE_SUDO_RS
	bool "sudo-rs (Rust sudo)"
	depends on BR2_PACKAGE_HOST_RUSTC_TARGET_ARCH_SUPPORTS
	depends on BR2_USE_MMU # fork()
	depends on BR2_ENABLE_LOCALE && BR2_USE_WCHAR # linux-pam
	depends on !BR2_STATIC_LIBS # linux-pam
	depends on BR2_TOOLCHAIN_GCC_AT_LEAST_4_9 # linux-pam
	depends on !BR2_PACKAGE_SUDO # both install /usr/bin/sudo
	select BR2_PACKAGE_HOST_RUSTC
	select BR2_PACKAGE_LINUX_PAM
	help
	  sudo-rs: a memory-safe reimplementation of sudo and visudo in
	  Rust, by the Trifecta Tech Foundation. The default sudo on
	  Ubuntu since 25.10. Reads the usual /etc/sudoers (and
	  @includedir /etc/sudoers.d), authenticates through PAM.

	  Installs sudo (setuid root), sudoedit (a symlink, sudo
	  dispatches on argv[0]) and visudo. Not su: util-linux's su
	  stays in Core.

	  https://github.com/trifectatechfoundation/sudo-rs

comment "sudo-rs needs a toolchain w/ wchar, locale, dynamic library, gcc >= 4.9"
	depends on BR2_PACKAGE_HOST_RUSTC_TARGET_ARCH_SUPPORTS
	depends on BR2_USE_MMU
	depends on !BR2_ENABLE_LOCALE || !BR2_USE_WCHAR || BR2_STATIC_LIBS || \
		!BR2_TOOLCHAIN_GCC_AT_LEAST_4_9
```

## buildroot-external/package/switcheroo-control/Config.in
```kconfig
config BR2_PACKAGE_SWITCHEROO_CONTROL
	bool "switcheroo-control"
	depends on BR2_PACKAGE_SYSTEMD
	select BR2_PACKAGE_LIBGUDEV
	help
	  Lists the GPUs of a hybrid machine over D-Bus
	  (net.hadess.SwitcherooControl): COSMIC's launcher, dock,
	  app library and store offer "Launch using discrete graphics"
	  through it.

	  https://gitlab.freedesktop.org/hadess/switcheroo-control
```

## buildroot-external/package/thermald-pengyos/Config.in
```kconfig
config BR2_PACKAGE_THERMALD_PENGYOS
	bool "thermald-pengyos (thermald against upower-pengyos)"
	depends on BR2_i386 || BR2_x86_64 # needs <cpuid.h>
	depends on BR2_USE_MMU # uses fork()
	depends on BR2_USE_WCHAR # upower -> libgudev
	depends on BR2_INSTALL_LIBSTDCPP
	depends on BR2_TOOLCHAIN_HAS_THREADS # dbus-glib -> glib2, dbus, upower
	depends on BR2_USE_WCHAR # dbus-glib -> glib2
	depends on BR2_PACKAGE_HAS_UDEV # upower
	select BR2_PACKAGE_DBUS
	select BR2_PACKAGE_DBUS_GLIB
	select BR2_PACKAGE_LIBEVDEV
	select BR2_PACKAGE_LIBXML2
	select BR2_PACKAGE_UPOWER_PENGYOS
	select BR2_PACKAGE_XZ
	help
	  Stock thermald, rebuilt to link upower-pengyos. The stock
	  recipe selects BR2_PACKAGE_UPOWER, which would build the
	  stock upower beside the fork. Same version as Buildroot's.
	  See divergence.toml: upower-1.91.5-fork.

	  Say no to thermald (BR2_PACKAGE_THERMALD) when you say yes
	  to this.

	  Thermal Daemon is a Linux daemon for monitoring and
	  controlling platform temperatures. Once the system temperature
	  reaches a certain threshold, the Linux daemon activates
	  various cooling methods to try to cool the system.

	  https://github.com/intel/thermal_daemon

comment "thermald-pengyos needs a toolchain w/ C++, wchar, threads"
	depends on BR2_i386 || BR2_x86_64
	depends on BR2_USE_MMU
	depends on !BR2_USE_WCHAR || !BR2_TOOLCHAIN_HAS_THREADS || \
		!BR2_INSTALL_LIBSTDCPP

comment "thermald-pengyos needs udev /dev management"
	depends on BR2_i386 || BR2_x86_64
	depends on BR2_USE_MMU
	depends on !BR2_PACKAGE_HAS_UDEV
```

## buildroot-external/package/upower-pengyos/Config.in
```kconfig
config BR2_PACKAGE_UPOWER_PENGYOS
	bool "upower-pengyos (fork of upower)"
	depends on BR2_PACKAGE_HAS_UDEV
	depends on BR2_TOOLCHAIN_HAS_THREADS # libgudev
	depends on BR2_USE_MMU # libgudev
	depends on BR2_USE_WCHAR # libgudev
	select BR2_PACKAGE_LIBGUDEV
	help
	  PengyOS's fork of UPower, pinned at a version newer than
	  the one Buildroot ships. It exists because Buildroot
	  2026.08 pins upower 0.99.19, whose battery reading freezes
	  after resume from suspend, and a br2-external tree cannot
	  move a stock package's version.
	  See divergence.toml: upower-1.91.5-fork.

	  Say no to upower (BR2_PACKAGE_UPOWER) when you say yes to
	  this: both install the same files, and the image must
	  carry one UPower. thermald selects the stock symbol, so
	  use thermald-pengyos.

	  UPower is an abstraction for enumerating power devices,
	  listening to device events and querying history and
	  statistics. Any application or service on the system can
	  access the org.freedesktop.UPower service via the system
	  message bus.

	  https://upower.freedesktop.org/

comment "upower-pengyos needs udev /dev management"
	depends on BR2_USE_MMU
	depends on !BR2_PACKAGE_HAS_UDEV

comment "upower-pengyos needs a toolchain w/ threads, wchar"
	depends on BR2_USE_MMU
	depends on !BR2_USE_WCHAR || !BR2_TOOLCHAIN_HAS_THREADS
```

## buildroot-external/package/uutils-coreutils/Config.in
```kconfig
config BR2_PACKAGE_UUTILS_COREUTILS
	bool "uutils-coreutils (Rust coreutils)"
	depends on BR2_PACKAGE_HOST_RUSTC_TARGET_ARCH_SUPPORTS
	depends on BR2_USE_MMU
	depends on BR2_TOOLCHAIN_USES_GLIBC
	select BR2_PACKAGE_HOST_RUSTC
	help
	  coreutils ~ GNU coreutils (updated), reimplemented in Rust by
	  uutils. Built as one multicall binary (`/usr/bin/coreutils`)
	  with a symlink per utility, so `ls`, `cp`, `stat`, `id`, `sync`,
	  `uname`, `whoami`, `install`, `stty`, `timeout` are ordinary
	  commands on PATH.

	  The unix feature set is built: the 78 common-core utilities plus
	  the unix-only ones GNU coreutils ships on Linux. MIT-licensed, so
	  the base system's licence stays MIT/Apache-2.0.

	  https://github.com/uutils/coreutils

comment "uutils-coreutils needs a glibc toolchain w/ MMU (utmpx for who/users/uptime)"
	depends on !BR2_PACKAGE_HOST_RUSTC_TARGET_ARCH_SUPPORTS || !BR2_USE_MMU || !BR2_TOOLCHAIN_USES_GLIBC
```

## buildroot-external/package/uutils-findutils/Config.in
```kconfig
config BR2_PACKAGE_UUTILS_FINDUTILS
	bool "uutils-findutils (Rust findutils)"
	depends on BR2_PACKAGE_HOST_RUSTC_TARGET_ARCH_SUPPORTS
	depends on BR2_USE_MMU # fork()
	depends on !BR2_PACKAGE_FINDUTILS # both install /usr/bin/find and xargs
	select BR2_PACKAGE_HOST_RUSTC
	select BR2_PACKAGE_ONIGURUMA # find -regextype, via the onig crate
	help
	  findutils ~ GNU findutils, reimplemented in Rust by uutils:
	  find, xargs, locate and updatedb. MIT-licensed.

	  https://github.com/uutils/findutils
```

## buildroot-external/package/uv/Config.in
```kconfig
config BR2_PACKAGE_UV
	bool "uv"
	depends on BR2_PACKAGE_HOST_RUSTC_TARGET_ARCH_SUPPORTS
	select BR2_PACKAGE_HOST_RUSTC
	help
	  uv is a Python package and project manager: venvs, pip
	  install, lock files, tools (uvx) and Python versions, in one
	  binary. On the host it manages each app's venv against the
	  system python3; wheels that need compiling are built in the
	  dev guest (see /usr/share/pengyos.txt).

	  https://github.com/astral-sh/uv
```

## buildroot-external/package/xdg-desktop-portal-gtk/Config.in
```kconfig
config BR2_PACKAGE_XDG_DESKTOP_PORTAL_GTK
	bool "xdg-desktop-portal-gtk"
	depends on BR2_PACKAGE_XDG_DESKTOP_PORTAL
	depends on BR2_PACKAGE_LIBGTK3
	select BR2_PACKAGE_FONTCONFIG
	select BR2_PACKAGE_GSETTINGS_DESKTOP_SCHEMAS
	help
	  The GTK portal backend: the portals COSMIC's own backend
	  does not implement, as Pop!_OS ships it. AppChooser (without
	  it xdg-desktop-portal does not offer OpenURI, so Flatpak
	  apps cannot open links or files in another app), Print,
	  Notification, Inhibit, Email, DynamicLauncher, Account,
	  Lockdown, and Settings for the org.gnome.* gsettings keys
	  (a Flatpak GTK app's titlebar buttons come from
	  org.gnome.desktop.wm.preferences button-layout). COSMIC's
	  backend still answers FileChooser, Screenshot, ScreenCast,
	  and Settings for org.freedesktop.appearance (portals.conf).

	  https://github.com/flatpak/xdg-desktop-portal-gtk
```

## buildroot-external/package/xdg-desktop-portal/Config.in
```kconfig
config BR2_PACKAGE_XDG_DESKTOP_PORTAL
	bool "xdg-desktop-portal"
	select BR2_PACKAGE_LIBGLIB2
	select BR2_PACKAGE_JSON_GLIB
	select BR2_PACKAGE_LIBFUSE3
	select BR2_PACKAGE_GDK_PIXBUF
	select BR2_PACKAGE_GSTREAMER1
	select BR2_PACKAGE_GST1_PLUGINS_BASE
	select BR2_PACKAGE_PIPEWIRE
	select BR2_PACKAGE_LIBGUDEV
	help

	  Portal frontend for sandboxed app sandbox/screencast/screenshot/etc.
	  Needs a backend (e.g. BR2_PACKAGE_XDG_DESKTOP_PORTAL_BACKEND_COSMIC).

	  https://gitlab.freedesktop.org/xdg/xdg-desktop-portal
```

## buildroot-external/package/xdg-user-dirs/Config.in
```kconfig
config BR2_PACKAGE_XDG_USER_DIRS
	bool "xdg-user-dirs"
	depends on BR2_USE_WCHAR # iconv
	help
	  Creates and records the well-known user folders (Desktop,
	  Documents, Downloads, Music, Pictures, Public, Templates,
	  Videos) in ~/.config/user-dirs.dirs. Browsers, portals and
	  file managers save to them; a Flatpak app granted
	  xdg-download writes to a Downloads folder that must exist.

	  https://www.freedesktop.org/wiki/Software/xdg-user-dirs/
```

## buildroot-external/package/xdg-utils/Config.in
```kconfig
config BR2_PACKAGE_XDG_UTILS
	bool "xdg-utils"
	help
	  freedesktop.org desktop integration scripts: xdg-open,
	  xdg-mime, xdg-settings, xdg-email, xdg-screensaver,
	  xdg-desktop-menu, xdg-desktop-icon, xdg-icon-resource.
	  Opens files and URLs with the user's default applications
	  (mimeapps.list) from scripts and the command line.

	  https://www.freedesktop.org/wiki/Software/xdg-utils/
```
