## buildroot-external/package/zram-generator/Config.in
```kconfig
config BR2_PACKAGE_ZRAM_GENERATOR
	bool "zram-generator"
	depends on BR2_PACKAGE_HOST_RUSTC_TARGET_ARCH_SUPPORTS
	depends on BR2_PACKAGE_SYSTEMD
	select BR2_PACKAGE_HOST_RUSTC
	help
	  systemd's generator for swap (and scratch) devices on zram:
	  compressed swap in RAM, the default on Fedora and Pop!_OS.
	  Ships a default /usr/lib/systemd/zram-generator.conf
	  (zstd, size min(RAM, 8 GiB)) and the matching VM tuning.

	  https://github.com/systemd/zram-generator
```

## buildroot-external/package/zsh-autosuggestions/Config.in
```kconfig
config BR2_PACKAGE_ZSH_AUTOSUGGESTIONS
	bool "zsh-autosuggestions"
	depends on BR2_PACKAGE_ZSH
	help
	  Suggests the rest of a history command as you type (accept
	  with Right). Pure shell, pinned upstream tag; sourced by the
	  PengyOS comfort profile (/etc/pengyos/shell/profile).

	  https://zsh-autosuggestions.zsh.dev
```

## buildroot-external/package/zsh-syntax-highlighting/Config.in
```kconfig
config BR2_PACKAGE_ZSH_SYNTAX_HIGHLIGHTING
	bool "zsh-syntax-highlighting"
	depends on BR2_PACKAGE_ZSH
	depends on BR2_PACKAGE_GIT # the git highlighter runs git
	help
	  Highlights the command line as you type (valid commands,
	  strings, errors), from the zsh community. Pure shell, pinned
	  upstream tag; sourced last by the PengyOS comfort profile
	  (/etc/pengyos/shell/profile).

	  https://github.com/zsh-users/zsh-syntax-highlighting
```

## prototypes/pengyos-jev/recipe/laya-model/Config.in
```kconfig
config BR2_PACKAGE_LAYA_MODEL
	bool "laya-model (System One decision weights, 450 MB Q8_0)"
	depends on BR2_PACKAGE_LLAMA_CPP_VK
	help
	  Laya: a 421 M-parameter System One (Jev-class) decision model,
	  Apache-2.0, multilingual (100+ languages), calibrated probabilities
	  from RLCD training, up to 8192 tokens on the multilingual checkpoint.
	  Installed to /usr/share/pengyos/jev/Laya-Q8_0.gguf.

	  Measured on a PengyOS Desktop Intel N100 (integrated GPU, Vulkan):
	  304 ms per decision, 146 MB peak RSS. CPU-only fallback: 405 ms,
	  96 MB.

	  https://huggingface.co/convaiinnovations/laya
```

## tools/pengyos-cosmic-native-deps/package/cosmic-portal/Config.in
```kconfig
config BR2_PACKAGE_XDG_DESKTOP_PORTAL_BACKEND_COSMIC
	bool "cosmic-portal"
	depends on BR2_PACKAGE_HOST_RUSTC_TARGET_ARCH_SUPPORTS
	select BR2_PACKAGE_HOST_RUSTC
	help

	  The COSMIC xdg-desktop-portal backend.

	  https://github.com/pop-os/xdg-desktop-portal-cosmic
```
