## buildroot-external/package/novnc/Config.in
```kconfig
config BR2_PACKAGE_NOVNC
	bool "novnc"
	help
	  noVNC's JavaScript VNC client library (core/ and the pako
	  zlib it imports), installed in /usr/share/novnc. pengy-vmm
	  serves it to show a VM's screen in the browser, over a
	  WebSocket that pengy-vmm proxies to the VM's private VNC
	  socket.

	  https://github.com/novnc/noVNC
```

## buildroot-external/package/papirus-icon-theme/Config.in
```kconfig
config BR2_PACKAGE_PAPIRUS_ICON_THEME
	bool "papirus-icon-theme"
	help
	  The Papirus icon theme, in its three variants (Papirus,
	  Papirus-Dark, Papirus-Light): the Desktop's default icons
	  since 2026-11-22, with the Glacier colour themes. Every MIME
	  type the image knows draws an icon of its own in each variant
	  (board/desktop/check-mime-icons.py). About 250 MB on disk.
	  The other variants in the archive (ePapirus, …) are not
	  installed.

	  https://github.com/PapirusDevelopmentTeam/papirus-icon-theme
```

## buildroot-external/package/restic/Config.in
```kconfig
config BR2_PACKAGE_RESTIC
	bool "restic"
	depends on BR2_PACKAGE_HOST_GO_TARGET_ARCH_SUPPORTS
	help
	  Encrypted, deduplicated backups to a local disk, SFTP, S3
	  (and Backblaze B2 through its S3 API) or a REST server: the
	  engine under pengyos-backup. Buildroot 2026.08 does not ship
	  it.

	  https://restic.net
```
