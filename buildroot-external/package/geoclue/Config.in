## buildroot-external/package/pengy-blocks/Config.in
```kconfig
config BR2_PACKAGE_PENGY_BLOCKS
	bool "pengy-blocks"
	depends on BR2_PACKAGE_HOST_RUSTC_TARGET_ARCH_SUPPORTS
	select BR2_PACKAGE_HOST_RUSTC
	help
	  Glacier Blocks: ten columns, twenty rows, all seven tetrominoes,
	  no mercy. The PengyOS pack-in game in the falling-blocks slot
	  (next to floe, merge, icefield, breakout, invaders, lander, pong,
	  solitaire and rogue). Rust, std only, zero dependencies: the recipe
	  is an offline cargo build and the game needs no libraries at run
	  time. Terminal=true, so it runs in any terminal, over ssh, and on
	  Core.

	  h/j/k/l (or the arrows) move and rotate, x/z rotate, space hard
	  drops, c holds, p pauses, r restarts, q quits. 7-bag, gravity from
	  800 ms down to 80 ms by level, wall kicks, a 300 ms lock delay, a
	  next-3 preview, and a best score kept in
	  $XDG_DATA_HOME/pengyos/games/pengy-blocks/, under the player's home.

	  --mono draws with plain ASCII when the locale cannot render the box
	  drawing characters; --headless proves it works where there is no pty.

	  https://github.com/pengyos/tree/main/tools/pengy-blocks
```

## buildroot-external/package/pengy-floe/Config.in
```kconfig
config BR2_PACKAGE_PENGY_FLOE
	bool "pengy-floe"
	depends on BR2_PACKAGE_HOST_RUSTC_TARGET_ARCH_SUPPORTS
	select BR2_PACKAGE_HOST_RUSTC
	help
	  Flappy Pengy: a one-button penguin flapper for the terminal, in the
	  PengyOS pack-in games set (the flappy-bird slot, next to merge,
	  icefield, pong, breakout, invaders, lander, blocks, solitaire and
	  rogue). Rust, std only, zero dependencies: the recipe is an offline
	  cargo build and the game needs no libraries at run time.
	  Terminal=true, so it runs in any terminal, over ssh, and on Core.

	  Space flaps, p pauses, r restarts, q quits. The high score is kept
	  in $XDG_DATA_HOME/pengyos/games/pengy-floe/, under the player's home.

	  https://github.com/patw/pengyos/tree/main/tools/pengy-floe
```

## buildroot-external/package/pengy-invaders/Config.in
```kconfig
config BR2_PACKAGE_PENGY_INVADERS
	bool "pengy-invaders"
	depends on BR2_PACKAGE_HOST_RUSTC_TARGET_ARCH_SUPPORTS
	select BR2_PACKAGE_HOST_RUSTC
	help
	  Thaw Invaders: something is melting the ice from above and you have
	  one laser. The 1978 formation - 11 columns x 5 rows of aliens, 2
	  cells wide, spaced 4 apart - marches across a 60x24 terminal field,
	  stepping one column every N ticks, reversing and descending at each
	  wall, dropping bombs. Three destructible 8x4 shields, three lives,
	  one laser in flight, waves that start lower and faster. The PengyOS
	  pack-in game in the invaders slot (next to pengy-pong, floe, merge,
	  icefield, breakout, lander, blocks, solitaire and rogue). Rust, std
	  only, zero dependencies: the recipe is an offline cargo build and the
	  game needs no libraries at run time. Terminal=true, so it runs in any
	  terminal, over ssh, and on Core.

	  a/d (or the arrow keys) move the ship, space fires the laser, p
	  pauses, r restarts, q quits. The high score is kept in
	  $XDG_DATA_HOME/pengyos/games/pengy-invaders/, under the player's home.

	  --headless and --replay prove the game with no terminal at all, which
	  is how the repo gate and pengyos-qemu-verify run it; --mono draws with
	  plain ASCII when the locale cannot render the box drawing characters.

	  https://github.com/pengyos/tree/main/tools/pengy-invaders
```

## buildroot-external/package/pengy-lander/Config.in
```kconfig
config BR2_PACKAGE_PENGY_LANDER
	bool "pengy-lander"
	depends on BR2_PACKAGE_HOST_RUSTC_TARGET_ARCH_SUPPORTS
	select BR2_PACKAGE_HOST_RUSTC
	help
	  Ice Lander: the 1979 Lunar Lander cart on the PengyOS terminal. A
	  60-metre ridge of ice broken by two to four flat landing pads worth
	  1x, 2x and 5x, a probe with 100 units of fuel, moon gravity (1.62
	  m/s^2) or asteroid gravity (5.0 m/s^2), and three numbers that all
	  have to be small when the feet touch: sideways speed under 1.0 m/s,
	  descent under 2.0 m/s, tilt under 5 degrees. Land, then n flies the
	  next wave on fresh terrain. Crash, and the run is over. The PengyOS
	  pack-in game in the lander slot (next to floe, merge, pong, icefield,
	  breakout, invaders, blocks, solitaire and rogue). Rust, std only, zero
	  dependencies: the recipe is an offline cargo build and the game needs
	  no libraries at run time. Terminal=true, so it runs in any terminal,
	  over ssh, and on Core.

	  space thrusts, a/d rotate, n is new terrain, r restarts, q quits
	  (Ctrl-C quits too). The high score is kept in
	  $XDG_DATA_HOME/pengyos/games/pengy-lander/, under the player's home.

	  --headless and --replay FILE prove the rules work with no pty, which
	  is how the repo gate and pengyos-qemu-verify run it. --mono draws with
	  plain ASCII when the locale cannot render the box drawing characters.

	  https://github.com/pengyos/tree/main/tools/pengy-lander
```

## buildroot-external/package/pengy-merge/Config.in
```kconfig
config BR2_PACKAGE_PENGY_MERGE
	bool "pengy-merge"
	depends on BR2_PACKAGE_HOST_RUSTC_TARGET_ARCH_SUPPORTS
	select BR2_PACKAGE_HOST_RUSTC
	help
	  Icefloe 2048: slide the ice floes, equal floes fuse into one bigger
	  floe, reach 2048. A PengyOS pack-in game (the 2048 slot, next to
	  floe, icefield, pong, breakout, invaders, lander, blocks, solitaire
	  and rogue). Rust, std only, zero dependencies: the recipe is an
	  offline cargo build and the game needs no libraries at run time.
	  Terminal=true, so it runs in any terminal, over ssh, and on Core.

	  hjkl or the arrow keys slide, u undoes one slide, r restarts, c
	  keeps playing after a win, q quits. The best score is kept in
	  $XDG_DATA_HOME/pengyos/games/pengy-merge/, under the player's home.

	  https://github.com/pengyos/tree/main/tools/pengy-merge
```

## buildroot-external/package/pengy-pong/Config.in
```kconfig
config BR2_PACKAGE_PENGY_PONG
	bool "pengy-pong"
	depends on BR2_PACKAGE_HOST_RUSTC_TARGET_ARCH_SUPPORTS
	select BR2_PACKAGE_HOST_RUSTC
	help
	  Penguin Pong: two paddles on a 60x20 field, one ball, first to
	  eleven (win by two at 10-10, hard cap 15). The PengyOS pack-in game
	  in the Pong slot (next to floe, merge, icefield, breakout, invaders,
	  lander, blocks, solitaire and rogue). Rust, std only, zero
	  dependencies: the recipe is an offline cargo build and the game needs
	  no libraries at run time. Terminal=true, so it runs in any terminal,
	  over ssh, and on Core.

	  w/s (or the arrow keys) move your paddle, 1/2/3 pick the penguin's
	  difficulty, m toggles 1P/2P hotseat, space serves, p pauses, r
	  restarts, q quits. The best result is kept in
	  $XDG_DATA_HOME/pengyos/games/pengy-pong/, under the player's home.

	  --mono draws with plain ASCII when the locale cannot render the box
	  drawing characters.

	  https://github.com/pengyos/tree/main/tools/pengy-pong
```

## buildroot-external/package/pengy-rogue/Config.in
```kconfig
config BR2_PACKAGE_PENGY_ROGUE
	bool "pengy-rogue"
	depends on BR2_PACKAGE_HOST_RUSTC_TARGET_ARCH_SUPPORTS
	select BR2_PACKAGE_HOST_RUSTC
	help
	  Ice Rogue: Rogue (1980), the original dungeon crawl — five floors
	  down, one penguin, permanent death, and at the bottom The Thaw. The
	  PengyOS pack-in game in the rogue slot (next to blocks, breakout,
	  floe, icefield, invaders, lander, merge, pong, solitaire). Rust, std
	  only, zero dependencies: the recipe is an offline cargo build and the
	  game needs no libraries at run time. Terminal=true, so it runs in any
	  terminal, over ssh, and on Core.

	  h/j/k/l (or the arrows) and y/u/b/n for the diagonals move, . waits,
	  g picks up, i shows the pack, > descends, q quits. Walk into a
	  monster to hit it. 12 hp, attack 1d4+1, defence 0; rats, ice crabs,
	  wolves, and a 20 hp boss on floor 5. Fish heal 3, a scroll maps the
	  floor, a parka is +1 defence, gold scores. Field of view radius 7
	  with line of sight; explored tiles stay drawn dim. Score is
	  floor*100 + gold + kills, and the best score is kept in
	  $XDG_DATA_HOME/pengyos/games/pengy-rogue/, under the player's home.

	  --mono draws with plain ASCII when the locale cannot render the box
	  drawing; --headless and --replay prove it works where there is no
	  pty.

	  https://github.com/pengyos/tree/main/tools/pengy-rogue
```
