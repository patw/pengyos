## buildroot-external/package/geoclue/Config.in
```kconfig
config BR2_PACKAGE_GEOCLUE
	bool "geoclue"
	depends on BR2_PACKAGE_SYSTEMD
	depends on BR2_USE_WCHAR # libglib2
	depends on BR2_TOOLCHAIN_HAS_THREADS # libglib2
	depends on BR2_USE_MMU # libglib2
	select BR2_PACKAGE_LIBGLIB2
	select BR2_PACKAGE_JSON_GLIB
	select BR2_PACKAGE_LIBSOUP3
	select BR2_PACKAGE_LIBNOTIFY # demo agent
	help
	  GeoClue 2 (org.freedesktop.GeoClue2): the location service
	  behind xdg-desktop-portal's Location portal. Wi-Fi networks
	  in range are looked up in BeaconDB (upstream's default since
	  Mozilla Location Service closed); a modem's GPS/cell data is
	  used when ModemManager is in the image.

	  https://gitlab.freedesktop.org/geoclue/geoclue/-/wikis/home
```

## buildroot-external/package/greetd/Config.in
```kconfig
config BR2_PACKAGE_GREETD
	bool "greetd"
	depends on BR2_PACKAGE_HOST_RUSTC_TARGET_ARCH_SUPPORTS
	select BR2_PACKAGE_HOST_RUSTC
	select BR2_PACKAGE_LINUX_PAM
	help

	  Minimal, distro-independent login daemon for Wayland/X11.

	  https://gitlab.com/greetd/greetd
```

## buildroot-external/package/gst1-libav-pengyos/Config.in
```kconfig
config BR2_PACKAGE_GST1_LIBAV_PENGYOS
	bool "gst1-libav-pengyos (against the ffmpeg fork)"
	depends on BR2_PACKAGE_FFMPEG_PENGYOS_ARCH_SUPPORTS
	depends on BR2_TOOLCHAIN_HAS_THREADS # ffmpeg
	select BR2_PACKAGE_FFMPEG_PENGYOS
	select BR2_PACKAGE_FFMPEG_PENGYOS_SWSCALE
	select BR2_PACKAGE_GST1_PLUGINS_BASE
	help
	  GStreamer plugin (formerly gst-ffmpeg).

	  This package contains GStreamer plugins based on
	  the libav project.

	  The codecs, muxers, bitstreams and filters to build can be
	  selected in the ffmpeg package.

	  https://gstreamer.freedesktop.org/

comment "gst1-libav needs a toolchain w/ threads"
	depends on !BR2_TOOLCHAIN_HAS_THREADS
```

## buildroot-external/package/hplip-pengyos/Config.in
```kconfig
config BR2_PACKAGE_HPLIP_PENGYOS
	bool "hplip-pengyos (fork of hplip)"
	depends on BR2_INSTALL_LIBSTDCPP
	depends on BR2_PACKAGE_CUPS
	depends on BR2_TOOLCHAIN_HAS_THREADS # libusb
	depends on BR2_TOOLCHAIN_GCC_AT_LEAST_4_9 # libusb
	depends on !BR2_STATIC_LIBS # libdl
	select BR2_PACKAGE_LIBUSB
	select BR2_PACKAGE_JPEG
	help
	  PengyOS's fork of HPLIP, pinned at a version newer than the one
	  Buildroot ships. It exists because Buildroot 2026.08 pins hplip
	  3.17.10 (2018) and 9 P1 CVE matches sit inside it, NVD names no fix
	  commit for any of them, and a br2-external tree cannot move a stock
	  package's version. See divergence.toml: hplip-3.26.4-fork.

	  Say no to hplip (BR2_PACKAGE_HPLIP) when you say yes to this: both
	  install the same files, and the image must carry one HPLIP.

	  HP Linux Imaging and Printing (HPLIP)
	  HPLIP is an HP-developed solution for printing, scanning, and
	  faxing with HP inkjet and laser based printers in Linux. The
	  HPLIP project provides printing support for 2,211 printer
	  models, including Deskjet, Officejet, Photosmart, PSC
	  (Print Scan Copy), Business Inkjet, LaserJet, Edgeline MFP,
	  and LaserJet MFP.

	  http://hplipopensource.com/

comment "hplip needs a toolchain w/ C++, threads, dynamic library, gcc >= 4.9"
	depends on BR2_PACKAGE_CUPS
	depends on !BR2_INSTALL_LIBSTDCPP || !BR2_TOOLCHAIN_HAS_THREADS || \
		BR2_STATIC_LIBS || !BR2_TOOLCHAIN_GCC_AT_LEAST_4_9
```

## buildroot-external/package/ipp-usb/Config.in
```kconfig
config BR2_PACKAGE_IPP_USB
	bool "ipp-usb"
	depends on BR2_PACKAGE_HOST_GO_TARGET_ARCH_SUPPORTS
	depends on BR2_PACKAGE_HOST_GO_TARGET_CGO_LINKING_SUPPORTS
	depends on BR2_PACKAGE_AVAHI_DAEMON
	select BR2_PACKAGE_HOST_GO
	select BR2_PACKAGE_LIBUSB
	select BR2_PACKAGE_AVAHI_LIBAVAHI_CLIENT
	help
	  IPP over USB: makes a driverless USB printer or scanner
	  (IPP Everywhere / AirPrint / eSCL — almost every printer sold
	  since ~2015) appear as a network printer on localhost, so
	  CUPS and SANE (airscan) use it with no driver. Started by udev
	  when such a device is plugged in.

	  https://github.com/OpenPrinting/ipp-usb
```

## buildroot-external/package/ldacbt/Config.in
```kconfig
config BR2_PACKAGE_LDACBT
	bool "ldacbt"
	depends on BR2_INSTALL_LIBSTDCPP # cmake project language
	help
	  Sony's LDAC Bluetooth audio encoder (AOSP libldac, built
	  standalone), for PipeWire's Bluetooth audio to Sony and other
	  LDAC headphones.

	  https://github.com/EHfive/ldacBT
```

## buildroot-external/package/libdisplay-info-pengyos/Config.in
```kconfig
config BR2_PACKAGE_LIBDISPLAY_INFO_PENGYOS
	bool "libdisplay-info-pengyos (fork of libdisplay-info)"
	depends on !BR2_PACKAGE_LIBDISPLAY_INFO
	select BR2_PACKAGE_HWDATA
	select BR2_PACKAGE_HWDATA_PNP_IDS
	help
	  PengyOS's fork of libdisplay-info, pinned at 0.3.0, OLDER
	  than the 0.4.0 Buildroot ships. cosmic-comp parses every
	  monitor's EDID with it and links libdisplay-info.so.3; its
	  libdisplay-info-sys crate accepts only >= 0.1.0, < 0.4.0, and
	  0.4.0 is soversion 4. Until this recipe the image carried the
	  build host's Ubuntu copy instead.
	  See divergence.toml: libdisplay-info-0.3.0-fork.

	  Say no to libdisplay-info (BR2_PACKAGE_LIBDISPLAY_INFO): both
	  install the same headers and pkg-config file.

	  EDID and DisplayID library.

	  https://gitlab.freedesktop.org/emersion/libdisplay-info
```

## buildroot-external/package/libfreeaptx/Config.in
```kconfig
config BR2_PACKAGE_LIBFREEAPTX
	bool "libfreeaptx"
	help
	  aptX and aptX HD Bluetooth audio codec (free implementation),
	  for PipeWire's Bluetooth audio.

	  https://github.com/regularhunter/libfreeaptx
```

## buildroot-external/package/libfyaml/Config.in
```kconfig
config BR2_PACKAGE_LIBFYAML
	bool "libfyaml"
	depends on BR2_TOOLCHAIN_HAS_THREADS
	help
	  A fully featured YAML 1.2 / JSON parser and emitter in C.
	  AppStream (and so Flatpak) reads its YAML metadata with it.
	  Not a stock Buildroot 2026.08 package.

	  https://github.com/pantoniou/libfyaml
```

## buildroot-external/package/libmtp/Config.in
```kconfig
config BR2_PACKAGE_LIBMTP
	bool "libmtp"
	select BR2_PACKAGE_LIBUSB
	help
	  Media Transfer Protocol: Android phones, cameras and media
	  players over USB. gvfs's MTP backend (so COSMIC Files shows the
	  phone) uses it. Buildroot 2026.08 does not ship it.

	  https://github.com/libmtp/libmtp
```

## buildroot-external/package/libnotify/Config.in
```kconfig
config BR2_PACKAGE_LIBNOTIFY
	bool "libnotify"
	depends on BR2_USE_WCHAR # libglib2
	depends on BR2_TOOLCHAIN_HAS_THREADS # libglib2
	depends on BR2_USE_MMU # libglib2
	select BR2_PACKAGE_LIBGLIB2
	select BR2_PACKAGE_GDK_PIXBUF
	help
	  The freedesktop desktop-notification client library and
	  notify-send, the command scripts use to raise a notification
	  (every desktop distro ships it; Buildroot has no package).

	  https://gitlab.gnome.org/GNOME/libnotify
```

## buildroot-external/package/libqalculate/Config.in
```kconfig
config BR2_PACKAGE_LIBQALCULATE
	bool "libqalculate"
	depends on BR2_INSTALL_LIBSTDCPP
	depends on BR2_USE_WCHAR
	depends on BR2_TOOLCHAIN_HAS_THREADS
	select BR2_PACKAGE_GMP
	select BR2_PACKAGE_MPFR
	select BR2_PACKAGE_LIBXML2
	help
	  The Qalculate! math library and its command-line calculator,
	  qalc. COSMIC's launcher (pop-launcher's calc plugin) runs qalc
	  for every "= 2+2" query; without it the calculator did nothing.

	  https://qalculate.github.io/
```

## buildroot-external/package/mdit/Config.in
```kconfig
config BR2_PACKAGE_MDIT
	bool "mdit"
	depends on BR2_PACKAGE_QT6
	depends on BR2_INSTALL_LIBSTDCPP
	select BR2_PACKAGE_QT6BASE_GUI
	select BR2_PACKAGE_QT6BASE_WIDGETS
	select BR2_PACKAGE_QT6BASE_PRINTSUPPORT # PDF export (QPdfWriter)
	help
	  mdit: a calm, native Markdown editor with a live preview
	  (Qt6 Widgets, no web engine). HTML and PDF export.

	  https://github.com/patw/mdit
```

## buildroot-external/package/nvidia-container-toolkit/Config.in
```kconfig
config BR2_PACKAGE_NVIDIA_CONTAINER_TOOLKIT
	bool "nvidia-container-toolkit"
	depends on BR2_PACKAGE_HOST_GO_TARGET_ARCH_SUPPORTS
	depends on BR2_PACKAGE_HOST_GO_TARGET_CGO_LINKING_SUPPORTS
	depends on BR2_PACKAGE_NVIDIA_OPEN
	select BR2_PACKAGE_HOST_GO
	help
	  NVIDIA Container Toolkit, CDI only: nvidia-ctk writes a
	  Container Device Interface spec for the GPUs and driver
	  (/var/run/cdi/nvidia.yaml) when the nvidia module loads, and
	  nvidia-cdi-hook runs inside containers that use it. Podman
	  then shares the GPUs with any container:
	    podman run --device nvidia.com/gpu=all ...
	  No nvidia-container-runtime or Docker integration.

	  https://github.com/NVIDIA/nvidia-container-toolkit
```

## buildroot-external/package/nvidia-open/Config.in
```kconfig
config BR2_PACKAGE_NVIDIA_OPEN
	bool "nvidia-open"
	depends on BR2_x86_64
	depends on BR2_TOOLCHAIN_USES_GLIBC # prebuilt userspace
	depends on BR2_LINUX_KERNEL
	depends on !BR2_PACKAGE_NVIDIA_DRIVER # both ship nvidia.ko
	help
	  NVIDIA's proprietary driver with the open GPU kernel modules
	  (Turing / RTX 20 and newer): nvidia, nvidia-modeset,
	  nvidia-drm and nvidia-uvm, the GSP firmware, CUDA + NVML
	  (nvidia-smi), NVENC/NVDEC, and the suspend/resume units.
	  nouveau is blacklisted. On its own this is the compute
	  driver a headless server needs; the graphics option adds
	  what a Wayland desktop needs.

	  Kernel modules and userspace come from the same .run, so
	  their versions can never drift apart.

	  https://github.com/NVIDIA/open-gpu-kernel-modules

if BR2_PACKAGE_NVIDIA_OPEN

config BR2_PACKAGE_NVIDIA_OPEN_GRAPHICS
	bool "graphics (EGL, GBM, Wayland)"
	depends on BR2_PACKAGE_MESA3D_GBM # libgbm: GBM backend + egl-gbm
	depends on BR2_PACKAGE_WAYLAND # egl-wayland platform libs
	depends on BR2_PACKAGE_LIBGLVND # libEGL_nvidia is a glvnd vendor lib
	help
	  The EGL/GLES/GBM/Wayland userspace a Wayland compositor
	  needs to render and scan out on an NVIDIA GPU.

	  On in the NVIDIA Desktop; off in the NVIDIA Server.

comment "graphics needs Mesa GBM, Wayland and libglvnd"
	depends on !BR2_PACKAGE_MESA3D_GBM || !BR2_PACKAGE_WAYLAND || \
		!BR2_PACKAGE_LIBGLVND

config BR2_PACKAGE_NVIDIA_OPEN_VULKAN
	bool "Vulkan driver"
	depends on BR2_PACKAGE_NVIDIA_OPEN_GRAPHICS
	depends on BR2_PACKAGE_XORG7 # the ICD lives in libGLX_nvidia (libX11)
	depends on BR2_INSTALL_LIBSTDCPP # vulkan-loader
	select BR2_PACKAGE_VULKAN_LOADER
	select BR2_PACKAGE_XLIB_LIBX11
	select BR2_PACKAGE_XLIB_LIBXEXT
	help
	  The NVIDIA Vulkan ICD and its layers (Optimus, present),
	  plus the Khronos loader. NVIDIA ships the ICD inside
	  libGLX_nvidia, which links libX11/libXext; it is also the
	  GLX vendor for OpenGL apps under Xwayland. Adds the X11 EGL
	  platforms (xcb, xlib) too.

	  On in the NVIDIA Desktop, which has the X.org libraries for
	  Xwayland. Flatpak apps (Steam, games) bring their own copy
	  from the Flathub GL extension matching this driver.

comment "Vulkan driver needs X.org libraries (BR2_PACKAGE_XORG7)"
	depends on BR2_PACKAGE_NVIDIA_OPEN_GRAPHICS
	depends on !BR2_PACKAGE_XORG7

config BR2_PACKAGE_NVIDIA_OPEN_PERSISTENCED
	bool "keep the GPUs initialized (nvidia-persistenced)"
	help
	  Run nvidia-persistenced whenever the driver is loaded, so a
	  headless GPU keeps its state between CUDA jobs: no driver
	  re-initialization at every start, and nvidia-smi answers
	  at once. For servers; it also keeps a laptop's dGPU from
	  powering down, so the NVIDIA Desktop leaves it off.

endif

comment "nvidia-open needs a glibc toolchain and a Linux kernel"
	depends on BR2_x86_64
	depends on !BR2_TOOLCHAIN_USES_GLIBC || !BR2_LINUX_KERNEL
```

## buildroot-external/package/nvtop/Config.in
```kconfig
config BR2_PACKAGE_NVTOP
	bool "nvtop"
	depends on BR2_PACKAGE_SYSTEMD # libsystemd: device enumeration
	depends on BR2_TOOLCHAIN_HAS_THREADS # libdrm
	depends on BR2_USE_WCHAR # ncurses
	depends on BR2_USE_MMU # libdrm amdgpu
	depends on BR2_TOOLCHAIN_HAS_SYNC_4 # libdrm amdgpu atomics
	select BR2_PACKAGE_NCURSES
	select BR2_PACKAGE_NCURSES_WCHAR
	select BR2_PACKAGE_LIBDRM
	select BR2_PACKAGE_LIBDRM_AMDGPU
	help
	  An htop-like monitor for GPUs: utilization, memory, clocks,
	  power, temperature and the processes using each GPU. NVIDIA
	  through NVML (dlopened, so the same build runs everywhere and
	  shows NVIDIA GPUs only where the driver is), AMD through
	  libdrm_amdgpu, Intel (i915, xe) through DRM fdinfo.

	  https://github.com/Syllo/nvtop
```

## buildroot-external/package/oo7/Config.in
```kconfig
config BR2_PACKAGE_OO7
	bool "oo7"
	depends on BR2_PACKAGE_HOST_RUSTC_TARGET_ARCH_SUPPORTS
	depends on BR2_PACKAGE_SYSTEMD # systemd-creds seals the keyring password
	depends on BR2_PACKAGE_DBUS
	select BR2_PACKAGE_HOST_RUSTC
	help
	  The Secret Service (org.freedesktop.secrets): where apps keep
	  passwords and login tokens (browsers, VS Code, the GitHub CLI,
	  anything using libsecret), plus the Secret portal for
	  sandboxed Flatpak apps. oo7-daemon replaces gnome-keyring.

	  The desktop logs in without a password, so the keyring's
	  password is random and sealed with systemd-creds (to the TPM
	  when there is one, else the machine's host key); oo7-session
	  unseals it when an app first asks for a secret.

	  https://github.com/linux-credentials/oo7
```

## buildroot-external/package/openssh-pengyos/Config.in
```kconfig
config BR2_PACKAGE_OPENSSH_PENGYOS
	bool "openssh-pengyos (fork of openssh)"
	depends on BR2_USE_MMU # fork()
	select BR2_PACKAGE_OPENSSL
	select BR2_PACKAGE_ZLIB
	select BR2_PACKAGE_LIBXCRYPT if BR2_TOOLCHAIN_USES_GLIBC
	help
	  PengyOS's fork of OpenSSH, pinned at a version newer than the one
	  Buildroot ships. It exists because OpenSSH 10.5p1 (Buildroot 2026.08)
	  carries remote, unauthenticated sshd vulnerabilities that upstream
	  fixed in 10.6, and a br2-external tree cannot move a stock package's
	  version. See divergence.toml: openssh-10.6p1-fork.

	  Say no to openssh (BR2_PACKAGE_OPENSSH) when you say yes to this:
	  both install the same files, and the image must carry one sshd.

	  Client programs: ssh, scp, sftp, ssh-agent, ssh-add, ssh-copy-id.
	  Server programs: sshd, sshd-session, sshd-auth, sftp-server.
	  Key utilities: ssh-keygen, ssh-keyscan.

	  https://www.openssh.com/

if BR2_PACKAGE_OPENSSH_PENGYOS

config BR2_PACKAGE_OPENSSH_PENGYOS_CLIENT
	bool "client"
	default y
	help
	  Client programs: ssh, scp, sftp, ssh-agent, ssh-add,
	  ssh-copy-id.

config BR2_PACKAGE_OPENSSH_PENGYOS_SERVER
	bool "server"
	default y
	help
	  Server programs: sshd, sshd-session, sshd-auth, sftp-server,
	  and the sshd.service unit.

config BR2_PACKAGE_OPENSSH_PENGYOS_KEY_UTILS
	bool "key utilities"
	default y
	help
	  Key utilities: ssh-keygen, ssh-keyscan. sshd.service runs
	  `ssh-keygen -A` on first boot, so a server image needs these.

config BR2_PACKAGE_OPENSSH_PENGYOS_SANDBOX
	bool "use sandboxing"
	default y
	help
	  Use sandboxing for extra privilege protection of processes.

	  This is normally preferable, but may cause seccomp problems
	  for certain combinations of C libraries and kernel versions.
endif
```
