## tools/pengyos-cosmic-native-deps/package/fonts/Config.in
```kconfig
config BR2_PACKAGE_FIRA_BRAND_BRICKS
	bool "fonts"
	help

	  The Fira + Noto font families COSMIC ships with.

	  https://gitlab.freedesktop.org/freedesktop/fonts
```

## tools/pengyos-cosmic-native-deps/package/xdg-desktop-portal/Config.in
```kconfig
config BR2_PACKAGE_XDG_DESKTOP_PORTAL
	bool "xdg-desktop-portal"
	help

	  Portal backend for sandboxed app sandbox/screencast/etc.

	  https://gitlab.freedesktop.org/xdg/xdg-desktop-portal
```

## tools/pengyos-hardening/tests/fixtures/mutations/sysctl-kptr-restrict/configs/pengyos_server_defconfig
```kconfig
# PengyOS server defconfig (hardened fixture).
BR2_ARCH="x86_64"
BR2_x86_64=y
BR2_INIT_SYSTEMD=y
BR2_ROOTFS_SUDO_SERVICE=y
BR2_PACKAGE_OPENSSH_SERVER=y
# Telnet and debug surfaces are off by policy.
# CONFIG_BR2_PACKAGE_TELNET is not set
# CONFIG_BR2_PACKAGE_NETCAT is not set
# CONFIG_BR2_PACKAGE_VALGRIND is not set
# CONFIG_BR2_TARGET_ROOTFS_TAR is not set
BR2_PACKAGE_PENGYOS_HARDENING=y
```

## tools/pengyos-jev/recipe/llama-cpp-vk/Config.in
```kconfig
config BR2_PACKAGE_LLAMA_CPP_VK
	bool "llama-cpp-vk (Vulkan-enabled llama-server, pinned)"
	depends on BR2_INSTALL_LIBSTDCPP
	depends on BR2_PACKAGE_LLAMA_CPP_ARCH_SUPPORTS
	depends on BR2_TOOLCHAIN_HAS_THREADS
	depends on BR2_TOOLCHAIN_GCC_AT_LEAST_11
	depends on BR2_USE_WCHAR
	select BR2_PACKAGE_VULKAN_LOADER
	help
	  A pinned, source-built llama-server with the Vulkan backend and the
	  /v1/systemone decision endpoint (llama.cpp >= b11318; the 2026.08
	  llama-cpp recipe pins b8117, which predates both). Lane 1: built
	  from source, statically linked against the ggml static libs.

	  NOT INSTALLED — this is the prototype skeleton. Two gaps must close
	  before it builds:
	    * host-shaderc (glslc) — ggml-vulkan's CMake does
	      find_package(Vulkan COMPONENTS glslc REQUIRED) and Buildroot
	      2026.08 ships no host-shaderc recipe; measured 2026-10-15.
	    * spirv-headers as a *build* dependency (find_package(SPIRV-Headers
	      CONFIG REQUIRED)); the target package is not enough.

	  https://github.com/ggml-org/llama.cpp
```

## tools/pengyos-recipe-server-clis/tests/fixtures/emit/package/btop/Config.in
```kconfig
config BR2_PACKAGE_BTOP
	bool "btop"
	help
	  btop is a high-performance terminal hardware and process
	  monitor — a modern replacement for top/htop showing CPU,
	  memory, disks, network and processes.

	  https://github.com/aristocratos/btop
```

## tools/pengyos-recipe-server-clis/tests/fixtures/emit/package/helix/Config.in
```kconfig
config BR2_PACKAGE_HELIX
	bool "helix"
	depends on BR2_PACKAGE_HOST_RUSTC_TARGET_ARCH_SUPPORTS
	select BR2_PACKAGE_HOST_RUSTC
	help
	  helix is a post-modern code editor written in Rust — an
	  evolutionary fork of kakoune with a built-in language server
	  protocol client.

	  https://github.com/helix-editor/helix
```

## tools/pengyos-recipe-server-clis/tests/fixtures/emit/package/neovim/Config.in
```kconfig
config BR2_PACKAGE_NEOVIM
	bool "neovim"
	help
	  neovim is a hyperextensible, Vim-based refactored text editor
	  with first-class language server protocol support.

	  https://github.com/neovim/neovim
```

## tools/pengyos-recipe-server-clis/tests/fixtures/emit/package/node_exporter/Config.in
```kconfig
config BR2_PACKAGE_NODE_EXPORTER
	bool "node_exporter"
	depends on BR2_PACKAGE_HOST_GO_TARGET_ARCH_SUPPORTS
	select BR2_PACKAGE_HOST_GO
	help
	  node_exporter runs a static HTTP server that exports
	  Prometheus metrics about the running machine for collection.

	  https://github.com/prometheus/node_exporter
```

## tools/pengyos-recipe-server-clis/tests/fixtures/emit/package/sd/Config.in
```kconfig
config BR2_PACKAGE_SD
	bool "sd"
	depends on BR2_PACKAGE_HOST_RUSTC_TARGET_ARCH_SUPPORTS
	select BR2_PACKAGE_HOST_RUSTC
	help
	  sd is an intuitive find-and-replace command line tool — a
	  friendlier replacement for sed.

	  https://github.com/chmln/sd
```

## tools/pengyos-recipe-server-clis/tests/fixtures/emit/package/zoxide/Config.in
```kconfig
config BR2_PACKAGE_ZOXIDE
	bool "zoxide"
	depends on BR2_PACKAGE_HOST_RUSTC_TARGET_ARCH_SUPPORTS
	select BR2_PACKAGE_HOST_RUSTC
	help
	  zoxide is a smarter cd command — it remembers which
	  directories you use most and lets you jump to them with a
	  keyword.

	  https://github.com/ajeetdsouza/zoxide
```

## tools/pengyos-recipe-uutils/package/uutils-coreutils/Config.in
```kconfig
config BR2_PACKAGE_UUTILS_COREUTILS
	bool "uutils-coreutils"
	depends on BR2_USE_MMU
	depends on (BR2_INSTALL_LIBC || BR2_TOOLCHAIN_USES_GLIBC)
help
	  coreutils ~ GNU coreutils (updated): a cross-platform
	  reimplementation of the GNU coreutils, written in Rust.

	  This recipe builds the single multicall 'coreutils' binary and
	  exposes every utility through a symlink to it (busybox-style
	  multi-call dispatch on argv[0]). Invoking '<pkg>-<utility>' runs
	  that utility; 'coreutils <utility>' lists and runs them too.

	  https://github.com/uutils/coreutils

comment "uutils-coreutils needs a toolchain w/ libc and MMU"
	depends on !BR2_USE_MMU || !(BR2_INSTALL_LIBC || BR2_TOOLCHAIN_USES_GLIBC)
```

## tools/pengyos-server-toolset/package/fzf/Config.in
```kconfig
config BR2_PACKAGE_FZF
	bool "fzf"
	depends on BR2_PACKAGE_HOST_GO_TARGET_ARCH_SUPPORTS
	select BR2_PACKAGE_HOST_GO
	help
	  fzf is a command-line fuzzy finder: an interactive,
	  multi-purpose filter over a list of options driven by
	  your input.

	  https://github.com/junegunn/fzf
```

## tools/pengyos-server-toolset/package/starship/Config.in
```kconfig
config BR2_PACKAGE_STARSHIP
	bool "starship"
	depends on BR2_PACKAGE_HOST_RUSTC_TARGET_ARCH_SUPPORTS
	select BR2_PACKAGE_HOST_RUSTC
	help
	  starship is a shell prompt, made fast! And able to display any
	  information you want in a few seconds.

	  https://github.com/starship/starship
```

## tools/pengyos-stt-whistle/recipe/needle-engine/Config.in
```kconfig
config BR2_PACKAGE_NEEDLE_ENGINE
	bool "needle-engine (Cactus STT/LLM runtime)"
	help
	  The Cactus Compute inference engine that runs the Whistle speech
	  model. A vendor prebuilt binary (Lane 2): there is no source, so the
	  binary is pinned by hash and installed under /usr/lib/pengyos/stt.

	  https://github.com/cactus-compute/needle

config BR2_PACKAGE_NEEDLE_ENGINE_ARCH_OK
	bool "upstream publishes a build for this architecture"
	depends on BR2_PACKAGE_NEEDLE_ENGINE
	default y if BR2_x86_64
	default y if BR2_aarch64
	default y if BR2_arm && BR2_ARM_CPU_ARMV7A
	default y if BR2_riscv && BR2_RISCV_64
	default y if BR2_mipsel
	help
	  Upstream ships prebuilt engines for linux-x86_64, linux-arm64,
	  linux-armv7, linux-riscv64 and linux-mipsel only. On any other
	  architecture the recipe fails rather than installing nothing.
```

## tools/pengyos-stt-whistle/recipe/whistle-model/Config.in
```kconfig
config BR2_PACKAGE_WHISTLE_MODEL
	bool "whistle-model (Cactus speech-to-text weights, 16.9 MB)"
	depends on BR2_PACKAGE_NEEDLE_ENGINE
	help
	  The Cactus Whistle speech-to-text model: one 16.9 MB .cact file,
	  Apache-2.0, transcribing English, German, French, Spanish, Italian,
	  Dutch and Polish on the CPU. Installed to
	  /usr/share/pengyos/stt/whistle.cact.

	  https://huggingface.co/Cactus-Compute/whistle
```

## tools/pengyos-upscale/recipe/realesrgan-ncnn-vulkan/Config.in
```kconfig
config BR2_PACKAGE_REALESRGAN_NCNN_VULKAN
	bool "realesrgan-ncnn-vulkan (neural image upscaler)"
	depends on BR2_x86_64
	select BR2_PACKAGE_VULKAN_LOADER
	select BR2_PACKAGE_LIBNOTIFY
	help
	  Real-ESRGAN: a neural network image upscaler (2x, 3x, 4x) built on
	  Tencent's ncnn with a Vulkan backend, shipped by the project as one
	  portable binary. Lane 2 (SPEC 2.5): the vendor's own prebuilt
	  binary, pinned by hash, installed under /usr/lib/pengyos/upscale.
	  No CUDA, no Python, no PyTorch.

	  Vulkan compute runs it on the GPUs this image already drives
	  (Intel/AMD through Mesa, NVIDIA through the NVIDIA edition), with
	  Mesa's llvmpipe as the CPU fallback.

	  Installs the pengyos-upscale command, the COSMIC Files right-click
	  actions ("Upscale 2x" / "Upscale 4x") and the "Open with" entry, so
	  enabling this package is the whole feature and disabling it removes
	  the whole feature.

	  https://github.com/xinntao/Real-ESRGAN

comment "realesrgan-ncnn-vulkan needs x86_64 (upstream publishes no other Linux build)"
	depends on !BR2_x86_64

if BR2_PACKAGE_REALESRGAN_NCNN_VULKAN

config BR2_PACKAGE_REALESRGAN_NCNN_VULKAN_MODEL_FAST
	bool "realesr-animevideov3 (fast, runs on the GPU)"
	default y
	help
	  3.7 MB, three graphs (x2/x3/x4). The only model measured to run on
	  a discrete GPU here: 1920x1080 -> 3840x2160 in 4.1 s on an RTX 5060
	  Ti. Tuned for anime and illustration, and the sensible default for
	  photos too, because it is the one that does not fall back to the CPU.

config BR2_PACKAGE_REALESRGAN_NCNN_VULKAN_MODEL_ANIME
	bool "realesrgan-x4plus-anime (9 MB)"
	help
	  The anime-tuned x4plus. Measured on this box: it fails to allocate
	  on the NVIDIA devices ("vkAllocateMemory failed -2") and runs on
	  llvmpipe.

config BR2_PACKAGE_REALESRGAN_NCNN_VULKAN_MODEL_PHOTO
	bool "realesrgan-x4plus (33 MB, best quality, slowest)"
	help
	  The general-photo model. Measured: 512x512 -> 2048x2048 in 51 s on
	  llvmpipe (it does not allocate on the NVIDIA devices here). Ship it
	  only where the CPU path is acceptable; it is 33 MB of weights.

endif
```
